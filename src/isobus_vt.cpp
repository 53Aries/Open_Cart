// Open_Cart
#include "isobus_vt.h"

#include "config.h"
#include "esp_log.h"

static const char* TAG = "isobus";

#if ENABLE_ISOBUS_BUILD

// ----------------------------------------------------------------------------
// ISOBUS Virtual Terminal client with the same tabs as the Wi-Fi page:
//   Home, Unloads, Fields, Calibrate, Setup.
// The object pool (isobus/scale.iop) and the IDs in isobus_ids.h are generated by
// isobus/make_pool.py. NOT yet run against a real VT (see isobus/README.md).
//
// Threading: the AgIsoStack++ worker thread calls the event callbacks. They only push a small
// command onto a queue; everything that touches NVS or the scale runs in isobus_task().
// ----------------------------------------------------------------------------
#include <algorithm>
#include <cmath>
#include <cstdio>
#include <cstring>
#include <ctime>
#include <memory>
#include <string>
#include <strings.h>
#include <unordered_map>
#include <vector>
#include "app.h"
#include "driver/twai.h"
#include "esp_mac.h"
#include "freertos/FreeRTOS.h"
#include "freertos/queue.h"
#include "freertos/task.h"
#include "isobus/hardware_integration/can_hardware_interface.hpp"
#include "isobus/hardware_integration/twai_plugin.hpp"
#include "isobus/isobus/can_network_manager.hpp"
#include "isobus/isobus/can_partnered_control_function.hpp"
#include "isobus/isobus/isobus_time_date_interface.hpp"
#include "isobus/isobus/isobus_virtual_terminal_client.hpp"
#include "isobus/utility/iop_file_interface.hpp"
#include "isobus_ids.h"
#include "unload_log.h"

#ifdef HAVE_SCALE_IOP
extern const uint8_t scale_iop_start[] asm("_binary_scale_iop_start");
extern const uint8_t scale_iop_end[] asm("_binary_scale_iop_end");
#endif

namespace {

using VT = isobus::VirtualTerminalClient;

enum Tab { TAB_HOME, TAB_UNL, TAB_FLD, TAB_CAL, TAB_SET, TAB_COUNT };

constexpr std::uint16_t kMaskId[TAB_COUNT] = {vtid::MASK_HOME, vtid::MASK_UNL, vtid::MASK_FLD, vtid::MASK_CAL, vtid::MASK_SET};

// Tab button object -> the tab it opens (each mask has its own copy of the bar).
struct TabButton { std::uint16_t id; Tab tab; };
#define TB(on) \
    {vtid::TAB_HOME_ON_##on, TAB_HOME}, {vtid::TAB_UNL_ON_##on, TAB_UNL}, {vtid::TAB_FLD_ON_##on, TAB_FLD}, \
    {vtid::TAB_CAL_ON_##on, TAB_CAL}, {vtid::TAB_SET_ON_##on, TAB_SET}
const TabButton kTabButtons[] = {TB(HOME), TB(UNL), TB(FLD), TB(CAL), TB(SET)};
#undef TB

// Input numbers on the Setup tab and how to turn their raw VT value into a real one.
struct SetupField { std::uint16_t id; double scale; };
const SetupField kSetup[] = {
    {vtid::S_INC, 0.1}, {vtid::S_WIN, 1}, {vtid::S_CELLS, 1}, {vtid::S_CAP, 1},
    {vtid::S_MV, 0.001}, {vtid::S_UDROP, 1}, {vtid::S_UQUIET, 0.1}, {vtid::S_UMIN, 1},
    {vtid::S_UAUTO, 1},
};

constexpr std::int32_t kWeightOffset = 100000;      // pool: Output Number offset for the weight (shows negatives)
constexpr std::int32_t kRawOffset = 8388608;        // ADC counts are signed 24-bit
constexpr int kMaxSendsPerTick = 12;

enum CmdType : std::uint8_t { CMD_KEY, CMD_NUMBER, CMD_STRING, CMD_TIME };
struct Cmd {
    CmdType type;
    std::uint16_t id;
    std::uint32_t value;
    char text[40];
};

std::shared_ptr<VT> g_vt;
isobus::TimeDateInterface g_time;

// Time and date broadcast by the tractor (ISOBUS PGN 65254). Offset is local minus UTC; known only
// once a message with valid fields has arrived.
bool g_td_valid = false;
int g_td_offset_min = 0;
QueueHandle_t g_q;

// ------------------------------------------------------------ formatting ----
std::string commas(double v) {
    long long n = std::llround(v);
    bool neg = n < 0;
    if (neg) n = -n;
    char digits[24];
    std::snprintf(digits, sizeof(digits), "%lld", n);
    std::string out;
    const int len = static_cast<int>(std::strlen(digits));
    for (int i = 0; i < len; ++i) {
        if (i && (len - i) % 3 == 0) out += ',';
        out += digits[i];
    }
    return neg ? "-" + out : out;
}

std::string trim(const char* s) {
    std::string t(s);
    while (!t.empty() && (t.back() == ' ' || t.back() == '\r' || t.back() == '\n')) t.pop_back();
    size_t a = 0;
    while (a < t.size() && t[a] == ' ') ++a;
    return t.substr(a);
}

// The VT font table is ISO 8859-1 and the pool strings are fixed width: keep to printable ASCII.
std::string ascii(const char* s, size_t maxlen) {
    std::string o;
    for (; *s && o.size() < maxlen; ++s) o += (static_cast<unsigned char>(*s) >= 32 && static_cast<unsigned char>(*s) < 127) ? *s : '?';
    return o;
}

// Days since 1970-01-01 for a civil date (proleptic Gregorian).
long long days_from_civil(int y, unsigned m, unsigned d) {
    y -= m <= 2;
    const long long era = (y >= 0 ? y : y - 399) / 400;
    const unsigned yoe = static_cast<unsigned>(y - era * 400);
    const unsigned doy = (153 * (m + (m > 2 ? -3 : 9)) + 2) / 5 + d - 1;
    const unsigned doe = yoe * 365 + yoe / 4 - yoe / 100 + doy;
    return era * 146097 + static_cast<long long>(doe) - 719468;
}

// "MM-DD HH:MM" in the tractor's local time, or UTC with a trailing Z when the tractor sent no offset.
std::string when_text(uint32_t epoch) {
    if (!epoch) return std::string(12, ' ');
    const bool local = g_td_valid;
    time_t t = static_cast<time_t>(epoch) + (local ? g_td_offset_min * 60 : 0);
    struct tm tm;
    gmtime_r(&t, &tm);
    char buf[24];
    std::snprintf(buf, sizeof(buf), "%02d-%02d %02d:%02d%c", tm.tm_mon + 1, tm.tm_mday, tm.tm_hour, tm.tm_min, local ? ' ' : 'Z');
    return buf;
}

// ------------------------------------------------------------- VT output ----
// Sends only what changed, and only while connected. A value counts as sent only if the stack accepted it.
struct Out {
    std::unordered_map<std::uint16_t, std::uint32_t> num;
    std::unordered_map<std::uint16_t, std::string> str;
    int budget = kMaxSendsPerTick;

    void reset() { num.clear(); str.clear(); }
    void forget(std::uint16_t id) { num.erase(id); str.erase(id); }

    void set_num(std::uint16_t id, std::uint32_t v) {
        auto it = num.find(id);
        if (it != num.end() && it->second == v) return;
        if (budget <= 0) return;
        --budget;
        if (g_vt->send_change_numeric_value(id, v)) num[id] = v;
    }
    void set_str(std::uint16_t id, const std::string& s, size_t cap) {
        std::string v = ascii(s.c_str(), cap);
        auto it = str.find(id);
        if (it != str.end() && it->second == v) return;
        if (budget <= 0) return;
        --budget;
        if (g_vt->send_change_string_value(id, v)) str[id] = v;
    }
};

Out g_out;

// ----------------------------------------------------------------- state ----
struct State {
    Tab tab = TAB_HOME;
    bool connected = false;

    // Unloads tab
    int u_page = 0;
    bool u_dirty = true;
    uint32_t u_seen_seq = 0xFFFFFFFF;
    size_t u_seen_count = 0;
    bool roll_armed = false;
    TickType_t roll_armed_at = 0;

    // Fields tab
    std::vector<std::string> list;
    size_t n_fields = 0;
    int f_cursor = 0;
    int f_top = 0;
    bool f_dirty = true;
    TickType_t f_polled = 0;
    bool del_armed = false;
    TickType_t del_armed_at = 0;
    std::string f_msg;

    // Home tab: ZERO key needs a second press
    bool zero_armed = false;
    TickType_t zero_armed_at = 0;

    // Calibrate tab
    double known_lb = 0;
    double cart_lb = 0;
    double cert_lb = 0;
    bool clr_armed = false;
    TickType_t clr_armed_at = 0;
    std::string c_msg;

    // Setup tab
    std::string s_msg;
    bool s_dirty = true;
};

State g_ui;   // VT screen state (isobus_task only)

void ui_message_reset() {
    g_ui.f_msg.clear();
    g_ui.c_msg.clear();
    g_ui.s_msg.clear();
    g_ui.roll_armed = g_ui.del_armed = g_ui.clr_armed = g_ui.zero_armed = false;
}

void goto_tab(Tab t) {
    if (t == g_ui.tab) return;
    if (g_vt->send_change_active_mask(vtid::WORKING_SET, kMaskId[t])) {
        g_ui.tab = t;
        g_out.reset();             // the new mask shows pool defaults: send everything again
        ui_message_reset();
        g_ui.u_dirty = g_ui.f_dirty = g_ui.s_dirty = true;
    }
}

// ------------------------------------------------------------- callbacks ----
// Run on the stack's worker thread: queue only.
void post(CmdType t, std::uint16_t id, std::uint32_t v, const char* text = nullptr) {
    Cmd c{};
    c.type = t;
    c.id = id;
    c.value = v;
    if (text) std::snprintf(c.text, sizeof(c.text), "%s", text);
    if (xQueueSend(g_q, &c, 0) != pdTRUE) ESP_LOGW(TAG, "VT event dropped (queue full)");
}

void on_key(const VT::VTKeyEvent& e) {
    if (e.keyEvent == VT::KeyActivationCode::ButtonPressedOrLatched) post(CMD_KEY, e.objectID, 0);
}
void on_number(const VT::VTChangeNumericValueEvent& e) { post(CMD_NUMBER, e.objectID, e.value); }
void on_string(const VT::VTChangeStringValueEvent& e) { post(CMD_STRING, e.objectID, 0, e.value.c_str()); }

void on_time(const isobus::TimeDateInterface::TimeAndDateInformation& info) {
    const auto& t = info.timeAndDate;
    if (t.year < 2020 || t.month < 1 || t.month > 12 || t.day < 1 || t.day > 31 || t.hours > 23 || t.minutes > 59 || t.seconds > 59) return;
    const long long days = days_from_civil(t.year, t.month, t.day);
    const long long epoch = days * 86400 + t.hours * 3600 + t.minutes * 60 + t.seconds;
    if (epoch < kClockValidEpoch || epoch > UINT32_MAX) return;
    const int off = t.localHourOffset * 60 + (t.localHourOffset < 0 ? -std::abs(t.localMinuteOffset) : std::abs(t.localMinuteOffset));
    post(CMD_TIME, static_cast<std::uint16_t>(static_cast<std::int16_t>(off)), static_cast<std::uint32_t>(epoch));
}

// --------------------------------------------------------------- actions ----
constexpr TickType_t kArmTimeout = pdMS_TO_TICKS(5000);

void do_tare(bool clear) {
    {
        AppLock l;
        if (clear) g_app.scale.clear_tare(); else g_app.scale.tare();
    }
    if (!app_persist_scale()) ESP_LOGE(TAG, "tare applied but not saved to flash");
}

void refresh_fields() {
    static char raw[kMaxFields][kFieldLen];
    const size_t n = fields_list(raw, kMaxFields);
    g_ui.list.assign(raw, raw + n);
    std::sort(g_ui.list.begin(), g_ui.list.end(), [](const std::string& a, const std::string& b) { return strcasecmp(a.c_str(), b.c_str()) < 0; });
    g_ui.n_fields = n;
    if (g_ui.f_cursor >= static_cast<int>(g_ui.n_fields)) g_ui.f_cursor = static_cast<int>(g_ui.n_fields) - 1;
    if (g_ui.f_cursor < 0) g_ui.f_cursor = 0;
    g_ui.f_dirty = false;
}

const char* const kNotSaved = "Could not save to flash; try again";
const char* const kCalNotSaved = "Applied, but NOT saved to flash (lost at restart)";

void apply_setup(std::uint16_t id, std::uint32_t raw) {
    double scale = 1;
    for (const auto& f : kSetup) if (f.id == id) scale = f.scale;
    const double v = raw * scale;
    bool in_range = true;
    bool saved = false;

    if (id == vtid::S_INC || id == vtid::S_WIN) {
        const SaveResult r = app_update_settings([&](Settings& s) {
            if (id == vtid::S_INC) {
                if (!display_increment_ok(v)) return false;
                s.display_increment_lb = v;
            } else {
                const long w = std::lround(v);
                if (!filter_samples_ok(w)) return false;
                s.filter_samples = static_cast<uint16_t>(w);
            }
            return true;
        });
        in_range = r != SaveResult::Invalid;
        saved = r == SaveResult::Ok;
        if (saved) {
            Settings s;
            AppLock l;
            s = g_app.settings;
            // Refills the filter (about 1 s); the unload detector pauses meanwhile.
            g_app.scale.configure(s.filter_samples, s.display_increment_lb, s.motion_threshold_lb);
        }
    } else if (id == vtid::S_CELLS || id == vtid::S_CAP || id == vtid::S_MV) {
        CellConfig c;
        { AppLock l; c = g_app.cells; }
        if (id == vtid::S_CELLS) {
            const long n = std::lround(v);
            in_range = CellConfig::cells_ok(n);   // check before narrowing to uint8_t
            if (in_range) c.n_cells = static_cast<uint8_t>(n);
        } else if (id == vtid::S_CAP) {
            c.capacity_lb = static_cast<float>(v);
        } else {
            c.mv_per_v = static_cast<float>(v);
        }
        in_range = in_range && c.valid();
        saved = in_range && app_save_cells(c);
    } else {
        UnloadConfig c = unload_cfg_load();
        if (id == vtid::S_UDROP) {
            in_range = UnloadTracker::start_drop_ok(v);
            c.start_drop_lb = static_cast<float>(v);
        } else if (id == vtid::S_UQUIET) {
            in_range = UnloadTracker::quiet_ok(v);
            c.end_quiet_s = static_cast<float>(v);
        } else if (id == vtid::S_UMIN) {
            in_range = UnloadTracker::min_unload_ok(v);
            c.min_unload_lb = static_cast<float>(v);
        } else if (id == vtid::S_UAUTO) {
            c.enabled = v >= 0.5;
        }
        saved = in_range && app_save_unload_cfg(c);
    }

    if (!in_range) {
        g_ui.s_msg = (id == vtid::S_CELLS || id == vtid::S_CAP || id == vtid::S_MV)
                         ? "Cells 1-12, 100-1,000,000 lb, 0.5-5 mV/V"
                         : "Value out of range";
    } else if (!saved) {
        g_ui.s_msg = kNotSaved;
    } else if (id == vtid::S_CELLS || id == vtid::S_CAP || id == vtid::S_MV) {
        g_ui.s_msg = "Saved. Re-calibrate if the real cells changed.";
    } else {
        g_ui.s_msg = "Saved";
    }
    g_ui.s_dirty = true;   // re-send the stored values so the VT shows what was really kept
    for (const auto& f : kSetup) g_out.forget(f.id);
}

void handle_key(std::uint16_t id) {
    for (const auto& b : kTabButtons) {
        if (b.id == id) { goto_tab(b.tab); return; }
    }
    if (id == vtid::K_PREVTAB) { goto_tab(static_cast<Tab>((g_ui.tab + TAB_COUNT - 1) % TAB_COUNT)); return; }
    if (id == vtid::K_NEXTTAB) { goto_tab(static_cast<Tab>((g_ui.tab + 1) % TAB_COUNT)); return; }

    const TickType_t now = xTaskGetTickCount();
    if (id == vtid::K_TARE) { do_tare(false); return; }
    if (id == vtid::K_UNTARE) { do_tare(true); return; }
    if (id == vtid::K_ZERO) {
        // Changes the saved calibration zero, so (like Delete) it needs a second press.
        if (g_ui.zero_armed && now - g_ui.zero_armed_at < kArmTimeout) {
            bool ok;
            { AppLock l; ok = g_app.scale.zero(); }
            if (ok && !app_persist_scale()) ESP_LOGE(TAG, "zero applied but not saved to flash");
            g_ui.zero_armed = false;
        } else {
            g_ui.zero_armed = true;
            g_ui.zero_armed_at = now;
        }
        return;
    }
    if (id == vtid::K_UNLOAD) { app_toggle_unload(); return; }

    if (g_ui.tab == TAB_UNL) {
        if (id == vtid::K_NEWER && g_ui.u_page > 0) { --g_ui.u_page; g_ui.u_dirty = true; }
        else if (id == vtid::K_OLDER) {
            if ((g_ui.u_page + 1) * vtid::kUnloadRows < static_cast<int>(unload_log_count())) { ++g_ui.u_page; g_ui.u_dirty = true; }
        } else if (id == vtid::K_ROLL) {
            uint32_t n = 0, pend = 0;
            bool need = false;
            unload_log_status(&n, &need, &pend);
            if (!need) return;
            if (g_ui.roll_armed && now - g_ui.roll_armed_at < kArmTimeout) {
                unload_log_continue();
                g_ui.roll_armed = false;
                g_ui.u_dirty = true;
            } else {
                g_ui.roll_armed = true;
                g_ui.roll_armed_at = now;
            }
        }
    } else if (g_ui.tab == TAB_FLD) {
        if (id == vtid::K_UP && g_ui.f_cursor > 0) --g_ui.f_cursor;
        else if (id == vtid::K_DOWN && g_ui.f_cursor + 1 < static_cast<int>(g_ui.n_fields)) ++g_ui.f_cursor;
        else if (id == vtid::K_USE && g_ui.n_fields) {
            field_set(g_ui.list[g_ui.f_cursor].c_str());
            g_ui.f_msg.clear();
        } else if (id == vtid::K_DELETE && g_ui.n_fields) {
            if (g_ui.del_armed && now - g_ui.del_armed_at < kArmTimeout) {
                field_remove(g_ui.list[g_ui.f_cursor].c_str());
                g_ui.del_armed = false;
                g_ui.f_msg.clear();
                refresh_fields();
            } else {
                g_ui.del_armed = true;
                g_ui.del_armed_at = now;
            }
        }
    } else if (g_ui.tab == TAB_CAL) {
        if (id == vtid::K_SETPT) {
            bool ok;
            { AppLock l; ok = g_app.scale.add_cal_point(g_ui.known_lb); }
            if (ok) g_ui.c_msg = app_persist_scale() ? "Point added" : kCalNotSaved;
            else g_ui.c_msg = "Not ready, table full, or weights not increasing with signal";
        } else if (id == vtid::K_CMPCAL) {
            // "The cart said X, a certified scale said Y"
            bool ok;
            { AppLock l; ok = g_app.scale.add_cal_from_reading(g_ui.cart_lb, g_ui.cert_lb); }
            if (ok) g_ui.c_msg = app_persist_scale() ? "Point added from certified scale" : kCalNotSaved;
            else g_ui.c_msg = "Needs zero set first, table not full, weights increasing with signal";
        } else if (id == vtid::K_CLRCAL) {
            if (g_ui.clr_armed && now - g_ui.clr_armed_at < kArmTimeout) {
                { AppLock l; g_app.scale.clear_calibration(); }
                g_ui.clr_armed = false;
                g_ui.c_msg = app_persist_scale() ? "Calibration cleared" : kCalNotSaved;
            } else {
                g_ui.clr_armed = true;
                g_ui.clr_armed_at = now;
            }
        }
    }
}

void handle_cmd(const Cmd& c) {
    switch (c.type) {
    case CMD_KEY:
        handle_key(c.id);
        break;
    case CMD_NUMBER:
        if (c.id == vtid::C_KNOWN) g_ui.known_lb = c.value * 0.1;
        else if (c.id == vtid::C_CART) g_ui.cart_lb = c.value * 0.1;
        else if (c.id == vtid::C_CERT) g_ui.cert_lb = c.value * 0.1;
        else for (const auto& f : kSetup) if (f.id == c.id) { apply_setup(c.id, c.value); break; }
        break;
    case CMD_TIME:
        g_td_offset_min = static_cast<std::int16_t>(c.id);
        g_td_valid = true;
        clock_set_from_client(c.value);   // only changes the clock if unset or more than 30 s off
        break;
    case CMD_STRING:
        if (c.id == vtid::F_NEW) {
            std::string name = trim(c.text);
            if (!name.empty()) {
                if (field_add(name.c_str())) { g_ui.f_msg = "Added"; g_ui.f_dirty = true; }
                else g_ui.f_msg = "List full (" + std::to_string(kMaxFields) + " max), name not allowed, or not saved";
            }
            g_out.forget(vtid::F_NEW);
            g_vt->send_change_string_value(vtid::F_NEW, std::string());   // clear the box
        }
        break;
    }
}

// --------------------------------------------------------------- screens ----
void show_home(const Snapshot& s) {
    double lb = std::max(-99999.0, std::min(s.display_lb, 899999.0));
    g_out.set_num(vtid::H_WEIGHT, static_cast<std::uint32_t>(std::lround(lb) + kWeightOffset));

    std::string st;
    auto add = [&st](const char* t) { if (!st.empty()) st += "  |  "; st += t; };
    if (s.stale) add("NO DATA FROM ADC");
    else if (!s.ready) add("warming up");
    else if (!s.has_cal) add("NOT CALIBRATED");
    else if (s.approximate) add("approximate (zero only)");
    if (s.motion) add("MOTION");
    if (st.empty()) st = "stable";
    g_out.set_str(vtid::H_STATUS, st, 40);

    std::string u;
    if (s.unloading) u = (s.unload_manual ? "Unloading (manual): " : "Unloading: ") + commas(s.unload_running_lb) + " lb";
    else if (s.has_last_unload) u = "Last unload: " + commas(s.last_unload_lb) + " lb";
    g_out.set_str(vtid::H_UNLOAD, u, 40);

    char field[kFieldLen];
    field_get(field, sizeof(field));
    double ft = 0;
    uint32_t fn = 0;
    field_total(&ft, &fn);
    g_out.set_str(vtid::H_FIELD, std::string("Field: ") + field, 60);
    g_out.set_str(vtid::H_FTOT, "Field total: " + commas(ft) + " lb (" + std::to_string(fn) + (fn == 1 ? " unload)" : " unloads)"), 60);
    g_out.set_str(vtid::H_TARE, "Tare " + commas(s.tare_lb) + " lb    Gross " + commas(s.gross_lb) + " lb", 60);

    {
        time_t now = time(nullptr);
        std::string clock = "Time: clock not set";
        if (now > kClockValidEpoch) {
            clock = "Time: " + when_text(static_cast<uint32_t>(now));
            clock += g_td_valid ? " (tractor)" : " (UTC)";
        }
        g_out.set_str(vtid::H_CLOCK, clock, 60);
    }

    uint32_t hc = 0, hp = 0;
    bool need = false;
    unload_log_status(&hc, &need, &hp);
    std::string w;
    if (need) w = "Unload history is FULL. Open the Unloads tab to roll over, or download it on the web page.";
    else if (hc >= UNLOAD_LOG_CAPACITY * 9 / 10) w = "Unload history is nearly full (" + std::to_string(hc) + " of " + std::to_string(UNLOAD_LOG_CAPACITY) + ").";
    if (g_ui.zero_armed && xTaskGetTickCount() - g_ui.zero_armed_at >= kArmTimeout) g_ui.zero_armed = false;
    if (g_ui.zero_armed) w = "Cart empty? Press ZERO again to zero the scale.";
    g_out.set_str(vtid::H_WARN, w, 120);
}

void show_unloads() {
    uint32_t count = 0, pend = 0;
    bool need = false;
    unload_log_status(&count, &need, &pend);
    const uint32_t newest = unload_log_newest_seq();
    if (newest != g_ui.u_seen_seq || count != g_ui.u_seen_count) { g_ui.u_seen_seq = newest; g_ui.u_seen_count = count; g_ui.u_dirty = true; }

    if (g_ui.roll_armed && xTaskGetTickCount() - g_ui.roll_armed_at >= kArmTimeout) g_ui.roll_armed = false;

    if (g_ui.u_dirty) {
        const int first = g_ui.u_page * vtid::kUnloadRows;
        if (first >= static_cast<int>(count) && g_ui.u_page > 0) { g_ui.u_page = 0; }
        const int start = g_ui.u_page * vtid::kUnloadRows;
        double page_total = 0;
        int shown = 0;
        static const std::uint16_t rows[vtid::kUnloadRows] = {
            vtid::U_ROW0, vtid::U_ROW1, vtid::U_ROW2, vtid::U_ROW3, vtid::U_ROW4, vtid::U_ROW5, vtid::U_ROW6,
            vtid::U_ROW7, vtid::U_ROW8, vtid::U_ROW9, vtid::U_ROW10, vtid::U_ROW11, vtid::U_ROW12, vtid::U_ROW13};
        for (int i = 0; i < vtid::kUnloadRows; ++i) {
            std::string line;
            UnloadRecord r;
            if (start + i < static_cast<int>(count) && unload_log_read(newest - static_cast<uint32_t>(start + i), &r)) {
                char buf[96];
                std::snprintf(buf, sizeof(buf), "#%-4u %s %-22.22s %7s lb", static_cast<unsigned>(r.seq), when_text(r.epoch).c_str(), r.field, commas(r.total_lb).c_str());
                line = buf;
                page_total += r.total_lb;
                ++shown;
            }
            g_out.set_str(rows[i], line, 70);
        }
        char hdr[64];
        if (count == 0) std::snprintf(hdr, sizeof(hdr), "Unloads: none recorded yet");
        else std::snprintf(hdr, sizeof(hdr), "Unloads %d-%d of %u (newest first)", start + 1, start + shown, static_cast<unsigned>(count));
        g_out.set_str(vtid::U_HDR, hdr, 60);
        g_out.set_str(vtid::U_FOOT, shown ? "Page total: " + commas(page_total) + " lb" : std::string(), 60);
        g_ui.u_dirty = false;
    }

    std::string m;
    if (g_ui.roll_armed) m = "Press Roll over again to overwrite the oldest unloads.";
    else if (need) m = "History FULL (" + std::to_string(UNLOAD_LOG_CAPACITY) + "). New unloads wait until you press Roll over.";
    else if (count >= UNLOAD_LOG_CAPACITY * 9 / 10) m = "History nearly full: " + std::to_string(count) + " of " + std::to_string(UNLOAD_LOG_CAPACITY);
    g_out.set_str(vtid::U_MSG, m, 120);
}

void show_fields() {
    TickType_t now = xTaskGetTickCount();
    if (g_ui.f_dirty || now - g_ui.f_polled > pdMS_TO_TICKS(2000)) { refresh_fields(); g_ui.f_polled = now; }
    if (g_ui.del_armed && now - g_ui.del_armed_at >= kArmTimeout) g_ui.del_armed = false;

    char cur[kFieldLen];
    field_get(cur, sizeof(cur));
    g_out.set_str(vtid::F_CUR, std::string("Current: ") + cur, 60);

    if (g_ui.f_cursor < g_ui.f_top) g_ui.f_top = g_ui.f_cursor;
    if (g_ui.f_cursor >= g_ui.f_top + vtid::kFieldRows) g_ui.f_top = g_ui.f_cursor - vtid::kFieldRows + 1;
    static const std::uint16_t rows[vtid::kFieldRows] = {
        vtid::F_ROW0, vtid::F_ROW1, vtid::F_ROW2, vtid::F_ROW3, vtid::F_ROW4, vtid::F_ROW5, vtid::F_ROW6, vtid::F_ROW7, vtid::F_ROW8};
    for (int i = 0; i < vtid::kFieldRows; ++i) {
        const int idx = g_ui.f_top + i;
        std::string line;
        if (idx < static_cast<int>(g_ui.n_fields)) {
            line = std::string(idx == g_ui.f_cursor ? ">" : " ") + (strcasecmp(g_ui.list[idx].c_str(), cur) == 0 ? "* " : "  ") + g_ui.list[idx];
        } else if (g_ui.n_fields == 0 && i == 0) {
            line = "  (no saved fields)";
        }
        g_out.set_str(rows[i], line, 40);
    }
    // The list can shrink under the cursor (another screen deleted fields): never index past its end.
    if (g_ui.f_cursor >= static_cast<int>(g_ui.list.size())) g_ui.del_armed = false;
    std::string m = g_ui.del_armed ? "Press Delete again to remove \"" + g_ui.list[g_ui.f_cursor] + "\"" : g_ui.f_msg;
    g_out.set_str(vtid::F_MSG, m, 60);
}

void show_cal(const Snapshot& s) {
    if (g_ui.clr_armed && xTaskGetTickCount() - g_ui.clr_armed_at >= kArmTimeout) g_ui.clr_armed = false;
    g_out.set_str(vtid::C_GROSS, "Gross " + commas(s.gross_lb) + " lb   Tare " + commas(s.tare_lb) + " lb", 60);
    g_out.set_str(vtid::C_RAW, "Raw counts: " + commas(s.raw), 60);

    CalPoint pts[MAX_CAL_POINTS];
    size_t n;
    { AppLock l; n = g_app.scale.get_calibration(pts, MAX_CAL_POINTS); }
    static const std::uint16_t rows[vtid::kCalRows] = {
        vtid::C_PT0, vtid::C_PT1, vtid::C_PT2, vtid::C_PT3, vtid::C_PT4, vtid::C_PT5, vtid::C_PT6, vtid::C_PT7};
    for (size_t i = 0; i < vtid::kCalRows; ++i) {
        std::string line;
        if (i < n) {
            char buf[80];
            std::snprintf(buf, sizeof(buf), "%u: %.1f lb = %s counts", static_cast<unsigned>(i + 1), pts[i].lb, commas(pts[i].raw).c_str());
            line = buf;
        } else if (i == 0) {
            line = "none";
        }
        g_out.set_str(rows[i], line, 60);
    }
    g_out.set_str(vtid::C_MSG, g_ui.clr_armed ? std::string("Press Clear cal again to delete all points.") : g_ui.c_msg, 120);
}

void show_setup() {
    Settings st;
    CellConfig cells;
    double cpl;
    { AppLock l; st = g_app.settings; cells = g_app.cells; cpl = g_app.scale.nominal_counts_per_lb(); }
    UnloadConfig uc = unload_cfg_load();
    auto raw = [](double v, double scale) { return static_cast<std::uint32_t>(std::lround(v / scale)); };
    g_out.set_num(vtid::S_INC, raw(st.display_increment_lb, 0.1));
    g_out.set_num(vtid::S_WIN, st.filter_samples);
    g_out.set_num(vtid::S_CELLS, cells.n_cells);
    g_out.set_num(vtid::S_CAP, raw(cells.capacity_lb, 1));
    g_out.set_num(vtid::S_MV, raw(cells.mv_per_v, 0.001));
    g_out.set_num(vtid::S_UDROP, raw(uc.start_drop_lb, 1));
    g_out.set_num(vtid::S_UQUIET, raw(uc.end_quiet_s, 0.1));
    g_out.set_num(vtid::S_UMIN, raw(uc.min_unload_lb, 1));
    g_out.set_num(vtid::S_UAUTO, uc.enabled ? 1 : 0);
    char info[96];
    std::snprintf(info, sizeof(info), "Full scale %s lb, %.2f counts/lb", commas(cells.total_capacity_lb()).c_str(), cpl);
    g_out.set_str(vtid::S_INFO, info, 80);
    g_out.set_str(vtid::S_MSG, g_ui.s_msg, 80);
}

void update_screen() {
    g_out.budget = kMaxSendsPerTick;
    const Snapshot s = app_snapshot();
    switch (g_ui.tab) {
    case TAB_HOME: show_home(s); break;
    case TAB_UNL: show_unloads(); break;
    case TAB_FLD: show_fields(); break;
    case TAB_CAL: show_cal(s); break;
    case TAB_SET: show_setup(); break;
    default: break;
    }
}

// ------------------------------------------------------------------ task ----
void isobus_task(void*) {
#ifndef HAVE_SCALE_IOP
    ESP_LOGE(TAG, "isobus/scale.iop not found at build time. Run: python isobus/make_pool.py");
    vTaskDelete(nullptr);
    return;
#else
    twai_general_config_t twaiConfig = TWAI_GENERAL_CONFIG_DEFAULT(
        static_cast<gpio_num_t>(PIN_CAN_TX), static_cast<gpio_num_t>(PIN_CAN_RX), TWAI_MODE_NORMAL);
    twai_timing_config_t twaiTiming = TWAI_TIMING_CONFIG_250KBITS();
    twai_filter_config_t twaiFilter = TWAI_FILTER_CONFIG_ACCEPT_ALL();
    auto canDriver = std::make_shared<isobus::TWAIPlugin>(&twaiConfig, &twaiTiming, &twaiFilter);

    isobus::CANHardwareInterface::set_number_of_can_channels(1);
    isobus::CANHardwareInterface::assign_can_channel_frame_handler(0, canDriver);
    isobus::CANHardwareInterface::set_periodic_update_interval(4);   // matches CONFIG_FREERTOS_HZ=250

    if (!isobus::CANHardwareInterface::start() || !canDriver->get_is_valid()) {
        ESP_LOGE(TAG, "CAN driver failed to start; check the transceiver wiring");
        vTaskDelete(nullptr);
        return;
    }

    uint8_t mac[6] = {};
    esp_read_mac(mac, ESP_MAC_WIFI_STA);
    uint32_t identity = (static_cast<uint32_t>(mac[3]) << 16 | static_cast<uint32_t>(mac[4]) << 8 | mac[5]) & 0x1FFFFF;

    isobus::NAME deviceName(0);
    deviceName.set_arbitrary_address_capable(true);
    deviceName.set_industry_group(2);   // agricultural and forestry
    deviceName.set_device_class(0);
    deviceName.set_function_code(static_cast<std::uint8_t>(isobus::NAME::Function::RateControl));   // pick what fits
    deviceName.set_identity_number(identity);
    deviceName.set_ecu_instance(0);
    deviceName.set_function_instance(0);
    deviceName.set_device_class_instance(0);
    // 1407 is the open-source code AgIsoStack++ documents for projects built on it.
    // Read the library README for the terms, and get your own code before selling units.
    deviceName.set_manufacturer_code(1407);

    auto internalECU = isobus::CANNetworkManager::CANNetwork.create_internal_control_function(deviceName, 0);

    const isobus::NAMEFilter vtFilter(isobus::NAME::NAMEParameters::FunctionCode,
                                      static_cast<std::uint8_t>(isobus::NAME::Function::VirtualTerminal));
    auto partnerVT = isobus::CANNetworkManager::CANNetwork.create_partnered_control_function(0, {vtFilter});

    g_q = xQueueCreate(16, sizeof(Cmd));
    if (!g_q) {
        ESP_LOGE(TAG, "out of memory creating the VT event queue");
        vTaskDelete(nullptr);
        return;
    }
    g_vt = std::make_shared<VT>(partnerVT, internalECU);

    // The pool vector must outlive the client.
    static std::vector<std::uint8_t> pool(scale_iop_start, scale_iop_end);
    std::string version = isobus::IOPFileInterface::hash_object_pool_to_version(pool);
    g_vt->set_object_pool(0, pool.data(), static_cast<std::uint32_t>(pool.size()), version);
    g_vt->set_object_pool_scaling(0, vtid::kDataMaskPx, vtid::kSoftKeyPx);
    g_vt->get_vt_soft_key_event_dispatcher().add_listener(on_key);
    g_vt->get_vt_button_event_dispatcher().add_listener(on_key);
    g_vt->get_vt_change_numeric_value_event_dispatcher().add_listener(on_number);
    g_vt->get_vt_change_string_value_event_dispatcher().add_listener(on_string);
    g_vt->initialize(true);
    g_time.get_event_dispatcher().add_listener(on_time);
    g_time.initialize();

    ESP_LOGI(TAG, "ISOBUS VT client started (pool %u bytes)", static_cast<unsigned>(pool.size()));
    for (;;) {
        Cmd c;
        // Wait for a command or the next screen refresh, whichever comes first.
        const bool got = xQueueReceive(g_q, &c, pdMS_TO_TICKS(250)) == pdTRUE;

        const bool up = g_vt->get_is_connected();
        if (up != g_ui.connected) {
            g_ui.connected = up;
            if (up) {
                // A fresh connection shows the pool defaults on the Home mask.
                ESP_LOGI(TAG, "VT connected");
                g_ui = State();
                g_ui.connected = true;
                g_out.reset();
            } else {
                ESP_LOGW(TAG, "VT disconnected");
            }
        }
        if (!up) {
            while (xQueueReceive(g_q, &c, 0) == pdTRUE) {}
            continue;
        }
        if (got) handle_cmd(c);
        while (xQueueReceive(g_q, &c, 0) == pdTRUE) handle_cmd(c);
        update_screen();
    }
#endif
}

}  // namespace

void isobus_start() {
    if (xTaskCreate(isobus_task, "isobus", 10240, nullptr, 5, nullptr) != pdPASS) ESP_LOGE(TAG, "could not start the ISOBUS task");
}

#else  // !ENABLE_ISOBUS_BUILD

void isobus_start() {
    ESP_LOGW(TAG, "ISOBUS is enabled in settings but this firmware was built without it. Use the s3_isobus build.");
}

#endif
